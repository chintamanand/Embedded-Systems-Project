	;Multiplication of 2, 4 digit BCD numbers available in the code memory (in unpacked ASCII form)
	;& store the product in the unpacked ASCII form in the RAM
	
	AREA RESET, DATA, READONLY
	EXPORT __Vectors
__Vectors
	DCD 0x40000000
	DCD Reset_Handler
	ALIGN
	AREA mycode, CODE, READONLY
	ENTRY
	EXPORT Reset_Handler
Reset_Handler
	LDR R0, =SRC1
	LDR R1, =SRC2
	LDR R2, =RES
	
	
	MOV R9, #04
	ADD R1, #16
	
CONVERT
	LDRH R3, [R1, #-4]!
	AND R3, #0X000F
	ADD R4, R3
	ROR R4, #04
	SUB R9, #01
	TEQ R9, #00
	BNE CONVERT
	
	ROR R4, #16
	
	MOV R1, R4		;R1 CONTAINS THE COUNTER IN BCD

	
MULTIPLY
	ADD R0, #32
	ADD R2, #32
	MOV R9, #0X00000000
	MSR XPSR, R9
	MOV R5, #08

LOOP

	LDRH R3, [R0, #-04]!
	LDRH R4, [R2, #-04]!
	
	AND R3, #0X0F
	AND R4, #0X0F
	ADC R3, R4
	CMP R3, #09
	BLS DOWN1
	ADD R3, #06
	AND R3, #0X0F
	MOV R9, #0X20000000
	B DOWN2
DOWN1
	MOV R9, #0X00000000
DOWN2
	MSR XPSR, R9
	LDR R8, =0X00000300
	ADD R8, R3
	
	STRH R8, [R2]
	SUB R5, #01
	TEQ R5, #00
	BNE LOOP
	
	;NOW DO BCD SUBTRACTION OF R1
		
	ADD R1, R1, #0XFFFFFFFF		;WE'RE DOING 2'S COMPLEMENT ADDITION OF 1
	MOV R3, #08
	LDR R4, =0X00000000
UP2
	AND R6, R1, #0X0F
	LSR R1, #04
	CMP R6, #0X0F
	BNE CONTINUE
	MOV R6, #0X00000009
CONTINUE
	ADD R4, R6
	ROR R4, #04
	SUB R3, #01
	TEQ R3, #00
	BNE UP2
	MOV R1, R4
	TEQ R1, #00
	BNE MULTIPLY
	
STOP B STOP 

SRC1 DCD 0, 0, 0, 0, 0X0306, 0X0304, 0X0302, 0X0309
SRC2 DCD 0X0309, 0X0309, 0X0309, 0X0309

	AREA myarea, DATA, READWRITE
RES DCD 0
	END
	
	